/*
 * Totem Max — right half overlay
 */

#include "totem_max.dtsi"

/ {
    chosen {
        zmk,kscan = &kscan0;
        zmk,matrix-transform = &default_transform;
    };

    kscan0: kscan {
        compatible = "zmk,kscan-gpio-matrix";
        label = "KSCAN_RIGHT";
        diode-direction = "col2row";

        row-gpios =
            <&gpio0 9  (GPIO_ACTIVE_HIGH | GPIO_PULL_DOWN)>,
            <&gpio0 10 (GPIO_ACTIVE_HIGH | GPIO_PULL_DOWN)>,
            <&gpio1 11 (GPIO_ACTIVE_HIGH | GPIO_PULL_DOWN)>,
            <&gpio1 13 (GPIO_ACTIVE_HIGH | GPIO_PULL_DOWN)>,
            <&gpio1 15 (GPIO_ACTIVE_HIGH | GPIO_PULL_DOWN)>
        ;

        col-gpios =
            <&gpio1 6  GPIO_ACTIVE_HIGH>,
            <&gpio1 4  GPIO_ACTIVE_HIGH>,
            <&gpio0 11 GPIO_ACTIVE_HIGH>,
            <&gpio1 0  GPIO_ACTIVE_HIGH>,
            <&gpio0 24 GPIO_ACTIVE_HIGH>,
            <&gpio0 22 GPIO_ACTIVE_HIGH>
        ;
    };
};

&default_transform {
    row-offset = <5>;
};
