/*
 * Totem Max — dongle overlay
 *
 * Dongle uses zmk,matrix-transform (same as peripherals)
 * for reliable split BLE transport. ZMK Studio is temporarily
 * disabled until the physical-layout split transport is verified.
 */

#include "totem_max.dtsi"

/ {
    chosen {
        zmk,kscan = &mock_kscan;
    };

    mock_kscan: mock_kscan_0 {
        compatible = "zmk,kscan-mock";
        columns = <12>;
        rows = <5>;
        events = <0>;
    };
};
