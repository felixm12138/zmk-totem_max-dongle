## config/boards/shields/totem_max/Kconfig.defconfig
```kconfig
if SHIELD_TOTEM_MAX_LEFT || SHIELD_TOTEM_MAX_RIGHT || SHIELD_TOTEM_MAX_DONGLE

config ZMK_KEYBOARD_NAME
    default "Totem Max"

config ZMK_SPLIT
    default y

config ZMK_BLE
    default y

endif

if SHIELD_TOTEM_MAX_DONGLE

config ZMK_SPLIT_ROLE_CENTRAL
    default y

config ZMK_SPLIT_BLE_CENTRAL_PERIPHERALS
    default 2

config BT_MAX_CONN
    default 7

config BT_MAX_PAIRED
    default 7

endif
```

## config/boards/shields/totem_max/Kconfig.shield
```kconfig
config SHIELD_TOTEM_MAX_LEFT
    def_bool $(shields_list_contains,totem_max_left)

config SHIELD_TOTEM_MAX_RIGHT
    def_bool $(shields_list_contains,totem_max_right)

config SHIELD_TOTEM_MAX_DONGLE
    def_bool $(shields_list_contains,totem_max_dongle)
```

## config/west.yml
```yaml
manifest:
  remotes:
    - name: zmkfirmware
      url-base: https://github.com/zmkfirmware
    - name: carrefinho
      url-base: https://github.com/carrefinho
    - name: felixm12138
      url-base: https://github.com/felixm12138
  projects:
    - name: zmk
      remote: zmkfirmware
      revision: main
      import: app/west.yml
    - name: prospector-zmk-module
      remote: felixm12138
      repo-path: zmk-totem_max-dongle
      revision: prospector-totem-display-fix
  self:
    path: config
```
